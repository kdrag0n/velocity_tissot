## arch/arm64/hotplug/Kconfig
```kconfig
config ASMP
 	bool "Multi-core automatic hotplug support"
 	depends on SMP
 	default n
 	help
 	Automatically hotplugs the multiple cpu cores on and off
 	based on cpu load and suspend stat

          Note that this will BREAK any runtime patching of the kernel text
          (i.e. anything that uses apply_alternatives,
          aarch64_insn_patch_text_nosync, etc. including the various CPU
          errata workarounds in arch/arm64/kernel/cpu_errata.c).

	  For MPU based protection-enabled targets please refer to
	  MSM_KERNEL_PROTECT_MPU

config THUNDERPLUG_CONTROL
	bool "Thunderplug plugging down/up of cores based on load per core"
	depends on SMP && HOTPLUG_CPU
	default n
	help
	  This driver hotplugs cpu cores based on per-core load

config BLU_PLUG
	bool "Dynamic hotplug driver"
	depends on HOTPLUG_CPU
	default n
	help
	  The Dynamic hotplug driver automatically online/offline CPUs proportional to system load. 

config MSM_HOTPLUG
	bool "MSM hotplug driver"
	depends on HOTPLUG_CPU
	default n
	help
	  The MSM hotplug driver controls on-/offlining of additional cores based
	  on current cpu load.
```

## drivers/usb/musb/Kconfig.rej
```kconfig
--- drivers/usb/musb/Kconfig
+++ drivers/usb/musb/Kconfig
@@ -140,7 +140,7 @@ config USB_TI_CPPI_DMA
 
 config USB_TI_CPPI41_DMA
 	bool 'TI CPPI 4.1 (AM335x)'
-	depends on ARCH_OMAP && DMADEVICES
+	depends on ARCH_OMAP
 	select TI_CPPI41
 
 config USB_TUSB_OMAP_DMA
```
